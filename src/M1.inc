;------------------------------------------
; Ввод символа с клавиатуры
;  вх:  нет
;  вых: A  = введенный символ
;------------------------------------------
	ROM_InputKeyA			EQU	0F803H


;------------------------------------------
; Ввод байта с магнитофона
;  вх:  A  = 0FFH - с поиском синхробайта
;       A  = 08H  - без поиска
;  вых: A  = введенный символ
;------------------------------------------
	ROM_LoadByteA			EQU	0F806H


;------------------------------------------
; Вывод символа на экран
;  вх:  C  = выводимый символ
;  вых: нет
;------------------------------------------
	ROM_DisplaySymC			EQU	0F809H


;------------------------------------------
; Запись байта на магнитофон
;  вх:  C  = записываемый байт
;  вых: нет
;------------------------------------------
	ROM_SaveByteC			EQU	0F80CH


;------------------------------------------
; Вывод символа на экран
;  вх:  A  = выводимый символ
;  вых: нет
;------------------------------------------
	ROM_DisplaySymA			EQU	0F80FH


;------------------------------------------
; Опрос состояния клавиатуры
;  вх:  нет
;  вых: A  = 00H  - не нажата
;       A  = 0FFH - нажата
;------------------------------------------
	ROM_GetKeyStateA		EQU	0F812H


;------------------------------------------
; Вывод байта на экран в HEX-коде
;  вх:  A  = выводимый символ
;  вых: нет
;------------------------------------------
	ROM_DisplayHexA			EQU	0F815H


;------------------------------------------
; Вывод на экран сообщений
;  вх:  HL = адрес начала сообщения, конечный байт - 00H
;  вых: нет
;------------------------------------------
	ROM_DisplayTextHL		EQU	0F818H


;------------------------------------------
; Ввод кода нажатой клавиши inkey
;  вх:  нет
;  вых: A  = 0FFH - не нажата
;       A  = 0FEH - РУС/ЛАТ
;       A  = код клавиши
;------------------------------------------
	ROM_InputkeyCodeA		EQU	0F81BH


;------------------------------------------
; Запрос положения курсора
;  вх:  нет
;  вых: H  = номер строки  Y (0—18Н)
;       L  = номер позиции X (0—3FH)
;------------------------------------------
	ROM_GetPosCursor		EQU	0F81EH


;------------------------------------------
; Чтение файла из магнитной ленты
;------------------------------------------
	ROM_LoadFile			EQU	0F824H


;------------------------------------------
; Запись файла на магнитную ленту
;  вх:  HL = нач. адрес массива
;       DE = конечный адрес
;  вых: нет
;------------------------------------------
	ROM_SaveFile			EQU	0F827H


;------------------------------------------
; Подсчет контрольной суммы блока
;  вх:  HL = адрес начала
;       DE = адрес конца
;  вых: BC = контрольная сумма
;------------------------------------------
	ROM_CalcControlSum		EQU	0F82AH


;------------------------------------------
; Распаковка внутреннего знакогенератора
;  вх:  нет
;  вых: нет
;------------------------------------------
	ROM_LoadCodePage		EQU	0F82DH


;------------------------------------------
; Чтение конечного адреса ОЗУ пользователя
;  вх:  нет
;  вых: HL = конечный адрес
;------------------------------------------
	ROM_LoadRamAddr			EQU	0F830H


;------------------------------------------
; Запись конечного адреса ОЗУ пользователя
;  вх:  HL = конечный адрес
;  вых: нет
;------------------------------------------
	ROM_SaveRamAddr			EQU	0F833H


;------------------------------------------
; Чтение байта из доп. страницы
;  вх:  HL = адрес
;       A  = N страницы (0-3)
;  вых: C  = считанный байт
;------------------------------------------
	ROM_LoadByteDisplayPage	EQU	0F836H


;------------------------------------------
; Запись байта в доп. страницы
;  вх:  HL = адрес
;       A  = N страницы (0-3)
;       C  = записываемый байт
;  вых: нет
;------------------------------------------
	ROM_SaveByteDisplayPage	EQU	0F839H


;------------------------------------------
; Установить положение курсора
;  вх:  H  = номер строки  Y (0—18Н)
;       L  = номер позиции X (0—3FH)
;  вых: нет
;------------------------------------------
	ROM_SetPosCursor		EQU	0F83CH
