;*****************************
;   П Е Р С О Н А Л Ь Н Ы Й 
;      К О М П Ь Ю Т Е Р
;    " О Р И О Н - 1 2 8 "
;
;    "ОТЛАДОЧНЫЙ  МОНИТОР"
;      ===== M1.R =====
;
;     КЛАВИАТУРА: "R-86RK"
;        29 НОЯБРЯ 1989
;         СУГОНЯКО В.П.
;*****************************
;
TVBT:EQU    0F3C9H ;START WCUR (C3H)
TBJMP:EQU    0F3CAH ;АДРЕС ПЕРЕХ.НА WCUR
TVST:EQU    0F3CCH ;START TV2 (C3H)
TVJMP:EQU    0F3CDH ;АДРЕС ПЕРЕХ. НА TV2
EKRAN:EQU    0F3CFH ;Н/АДР.ЭКРАНА(0C0H)
EKRED:EQU    0F3D0H ;РАЗМЕР ЭКРАНА (30H)
ZNAKG:EQU    0F3D1H ;НАЧ.АДР.ЗНАКОГЕНЕР.
INVERS:EQU    0F3D3H ;ПРЯМОЙ/ИНВЕРС СИМВ.
TVAD:EQU    0F3D4H ;АДР.СТОЛБ. КУРСОРА
TVAD1:EQU    0F3D5H ;АДР.СТРОКИ КУРСОРА
;
MNJMP:EQU    0F3D8H ;А/ВОЗВ.ИЗ ERR-MGG
TIM50:EQU    0F3DAH ;КОНСТАНТА ЗАП. MG
TIM75:EQU    0F3DBH ;КОНСТ.ЧТЕНИЯ MG
FLMN:EQU    0F3DCH ;ФЛАГ ИНВЕРС.MG
TB1:EQU    0F3DDH ;С/ЯЧ1 (ПРОГ.TV)
TB2:EQU    0F3DEH ; !!!!
TIMES:EQU    0F3DFH ;С/ПАРА N1(ПРОГ.ТV)
TIMES2:EQU    0F3E1H ;АДРЕС TV2 В МОНИТ.
MEMOR:EQU    0F3E3H ;МАХ АДР.ОЗУ
FFIX:EQU    0F3E5H ;ТРИГЕР "РУС/ЛАТ"
SIMV:EQU    0F3E6H ;ПОСЛ.ВВЕД.СИМВ.
;
LOW:EQU    0F3EEH ;ЯЧ. I-ОПЕРАНДА
LOW1:EQU    0F3EFH
INBF:EQU    0F3F0H
INBF1:EQU    0F3F1H
INBF2:EQU    0F3F2H
INBFE:EQU    0F3FFH
;
PKA:EQU    0F400H ; F400 - ПОРТ KBRD
PKB:EQU    0F401H ; F500 - ROM/DISK
PKC:EQU    0F402H ; F600 - ПОРТ PRINT
PKU:EQU    0F403H ; 
PDA:EQU    0F500H ; ПОРТ ROMDISK
PDB:EQU    0F501H
PDC:EQU    0F502H
PDU:EQU    0F503H
;
PORTS1:EQU    0F800H ; ЦВЕТ/РЕЖ./ПАЛИТРА
PORTS2:EQU    0F900H ; ПЕРЕКЛ.СТРАНИЦ
PORTS3:EQU    0FA00H ; ПЕРЕКЛ. ЭКРАНОВ
;
FIX:EQU       80H ;"РУС/ЛАТ"  "ФИКС"
US:EQU       40H ;"УС"       "СУ"
SS:EQU       20H ;"СС"       "РЕГ"
;
POLZ:EQU    0BFFDH ; ------------
ZONA:EQU    0F000H ; ДОП.ОЗУ/ПЗУ
NAZG:EQU    0FE48H ;*
;
;
ORG    0F800H ;*
;
START:JMP ST1
JMP KBRD      ;ВХ.НА ПП ОБР.КЛ-РЫ
JMP MIN       ;-"-ЧТ.БАЙТА С MG
TVX:JMP TVST      ;-"-ВЫВ.СИМВ.НА TV
JMP MOUT      ;-"-ЗАП.БАЙТА НА MG
JMP TV        ;-"-ВЫВ.СИМВ (A)=>TV
JMP STTS      ;-"-ПРOВ.СТАТ.КЛАВ.
JMP ASC       ;-"-БАЙТ=>TV(2ASCII)
JMP MSG       ;-"-ВЫВ.СИМВ.СООБЩ.
JMP INKEY     ;ВВОД КОДА НАЖ.КЛАВ.
JMP RCUR      ;ПОЛОЖЕНИЕ КУРСОРА
JMP TVBT      ;УСТАНОВКА КУРСОРА
JMP MGI       ;ЧТ.ПРОГРАМ. В ОЗУ
JMP MGO       ;ЗП.ПРОГРАМ. НА МАГ.
JMP CSM       ;СЧЕТ КОНТР.СУММЫ
JMP RPAC      ;РАСПАК. ЗНАК.ГЕН
JMP RMAX      ;MAX РАЗМЕР ОЗУ
JMP WMAX      ;УСТ.МАХ РАЗМ.ОЗУ
JMP RRAM      ;ЧТ.БАЙТА ДОП.СТРАН.
JMP WRAM      ;ЗП.БАЙТА ДОП.СТРАН.
JMP WCUR      ;УСТАНОВКА КУРСОРА
RET           ;РЕЗЕРВНЫЙ ВХОД
DW  00H
;
ST1:LXI  SP,TVBT 
XRA  A
STA  PORTS1   ;ВЫКЛЮЧ. СТАРТ.МЕХ.
STA  PORTS2
STA  PORTS3
STA  INVERS 
STA  PKC 
MVI  A,0C3H
STA  TVST 
STA  TVBT 
CALL INITTV 
LXI  H,573BH
SHLD TIM50 
LXI  H,TAB2 
CALL MSG 
UR:LXI  SP,TVBT 
MVI  A,8AH
STA  PKU 
LXI  H,TAB3 
CALL MSG 
STA  FFIX 
LXI  H,ERR 
SHLD MNJMP 
LXI  H,UR 
PUSH H
CALL CDIN 
CALL HDLN 
CALL CVRT 
LDA  INBF 
CPI  'M'
JZ   MEMR 
CPI  'D'
JZ   DAMP 
CPI  'I'
JZ   MGI 
CPI  'O'
JZ   MGO 
CPI  'R'
JZ   READ 
CPI  'Z'
JZ   POLZ 
CPI  'C'
JZ   COLOR 
CPI  'G'
JNZ  ERR 
PCHL
;
INITTV:LXI  H,ZONA 
SHLD ZNAKG
CALL RPAC 
LXI  H,30C0H
SHLD EKRAN 
LXI  H,TV2
SHLD TVJMP 
LXI  H,INH 
SHLD TBJMP 
LXI  H,0BFFFH
SHLD MEMOR 
INH:RET
;
CDIN:LXI  D,INBF 
CD1:CALL KBRD 
CPI  '.'
JZ   ERR 
CPI  7FH
JZ   CD4 
CPI  18H
JZ   CD3 
CPI  08H
JNZ  CD2 
MVI  A,INBF
CMP  E
JZ   CD1 
CD5:MVI  A,08H
DCX  D
CD4:CALL TV 
JMP  CD1 
CD2:STAX D
CD3:CALL TV 
CPI  0DH
RZ
INX  D
MOV  A,E
CPI  INBFE
JNZ  CD1 
JMP  CD5 
;
CVRT:LXI  D,INBF1 
CALL CVRT2 
SHLD LOW 
RC
CALL CVRT2 
XCHG
LHLD LOW 
RET
;
CVRT2:LXI  H,00H
MOV  B,L
MOV  C,L
HEX:DAD  B
LDAX D
INX  D
CPI  0DH
JZ   RTN 
CPI  2CH
RZ
SUI  30H
JM   ERR 
CPI  0AH
JM   HX 
CPI  11H
JM   ERR 
CPI  17H
JP   ERR 
SUI  07H
HX:MOV  C,A
DAD  H
DAD  H
DAD  H
DAD  H
JNC  HEX 
ERR:MVI  A,3FH
CALL TV 
JMP  UR 
RTN:LXI  D,00H
STC
RET
;
AS:MOV  A,M
ASC:PUSH PSW
RRC
RRC
RRC
RRC
CALL AS1 
POP  PSW
AS1:ANI  0FH
CPI  0AH
JM   AS2 
ADI  07H
AS2:ADI  30H
PUSH B
MOV  C,A
CALL TVX 
POP  B
RET
;
MSG:MOV  A,M
ANA  A
RZ
PUSH B
MOV  C,A
CALL TVX 
POP  B
INX  H
JMP  MSG 
;
CSM:LXI  B,00H
CSM1:MOV  A,C
ADD  M
MOV  C,A
PUSH PSW
CALL DPCMP 
JZ   CMT1 
POP  PSW
MOV  A,B
ADC  M
MOV  B,A
INX  H
JMP  CSM1 
;
MCT:CALL HDLN 
CALL SPC 
ADR:MOV  A,H
CALL ASC 
MOV  A,L
CALL ASC 
SPC:MVI  A,20H
JMP  TV 
;
DPCMP:MOV  A,H
CMP  D
RNZ
MOV  A,L
CMP  E
RET
;
RCUR:LHLD TVAD 
MOV  A,L
RRC
RRC
MOV  L,A
RET
;
WCUR:MOV  A,L
RLC
RLC
MOV  L,A
SHLD TVAD 
RET
;
WMAX:SHLD MEMOR 
RMAX:LHLD MEMOR 
RET
;
RPAC:LXI  H,NAZG
LXI  D,ZONA 
RPC:MVI  C,07H
XRA  A
STAX D
INX  D
RPC1:MOV  A,M
RLC
RLC
RLC
ANI  07H
MOV  B,A
RPC2:MOV  A,M
ANI  1FH
STAX D
INX  D
DCR  C
DCR  B
JP   RPC2 
INX  H
MOV  A,H
ANA  A
RZ
MOV  A,C
ANA  A
JNZ  RPC1 
JMP  RPC 
;
RRAM:STA  PORTS2
MOV  C,M
RRM:XRA  A
STA  PORTS2
RET
;
WRAM:STA  PORTS2
MOV  M,C
JMP  RRM 
;
MIN0:MVI  A,08H
MIN:PUSH B
PUSH D
PUSH H
MVI  C,00H
MOV  D,A
LDA  PKC 
RRC
RRC
RRC
RRC
ANI  01H
MOV  E,A
CMN:MOV  A,C
ANI  7FH
RLC
MOV  C,A
MVI  B,00H
ISM:DCR  B
JNZ  ISM2 
ISM1:LHLD MNJMP 
PCHL
ISM2:LDA  PKC 
RRC
RRC
RRC
RRC
ANI  01H
CMP  E
JZ   ISM 
ORA  C
MOV  C,A
CALL T75 
LDA  PKC 
RRC
RRC
RRC
RRC
ANI  01H
MOV  E,A
MOV  A,D
ORA  A
JP   STR 
MOV  A,C
CPI  0E6H
JNZ  IMN 
XRA  A
STA  FLMN 
JMP  STR1 
IMN:CPI  19H
JNZ  CMN 
MVI  A,0FFH
STA  FLMN 
STR1:MVI  D,09H
STR:DCR  D
JNZ  CMN 
LDA  FLMN 
XRA  C
STR2:POP  H
POP  D
POP  B
RET
;
MGHL:MOV  C,H
CALL MOUT 
MOV  C,L
;
MOUT:PUSH PSW
PUSH D
PUSH B
MVI  D,08H
CMT:MOV  A,C
RLC
MOV  C,A
MVI  A,01H
XRA  C
STA  PKC 
CALL T50 
XRA  A
XRA  C
STA  PKC 
CALL T50 
DCR  D
JNZ  CMT 
POP  B
POP  D
CMT1:POP  PSW
RET
;
T50:LDA  TIM50 
JMP  TM 
T75:LDA  TIM75 
TM:DCR  A
JNZ  TM 
RET
;
M1:INX  H
MEMR:CALL MCT 
CALL AS 
CALL SPC 
CALL CDIN 
LXI  D,INBF 
LDAX D
CPI  0DH
JZ   M1 
PUSH H
CALL CVRT2 
XCHG
POP  H
MOV  M,E
JMP  M1 
;
DAMP:MOV  B,E
DD:CALL MCT 
D11:CALL SPC 
MOV  A,B
ANA  A
JZ   D12 
CALL RRAM 
MOV  A,C
JMP  D13 
D12:MOV  A,M
D13:CALL ASC 
INX  H
MOV  A,L
ANI  0FH
JNZ  D11 
MOV  A,L
ANA  A
JNZ  DD 
CALL CDIN 
JMP  DD
;
MGI:MVI  A,0FFH
CALL HLMS 
XCHG
CALL HLMG 
XCHG
PUSH H
MGI1:CALL MIN0 
MOV  M,A
CALL DPCMP 
INX  H
JNZ  MGI1 
MVI  A,0FFH
CALL HLMS 
MOV  B,H
MOV  C,L
POP  H
CALL ADR 
XCHG
CALL ADR 
XCHG
PUSH B
CALL CSM 
POP  D
MOV  H,B
MOV  L,C
CALL ADR 
CALL DPCMP 
RZ
JMP  ISM1 
;
HLMG:MVI  A,08H
HLMS:CALL MIN 
MOV  H,A
CALL MIN0 
MOV  L,A
RET
;
MGO:PUSH H
CALL CSM 
POP  H
PUSH B
PUSH H
LXI  B,00H
MG2:CALL MOUT 
DCR  B
JNZ  MG2 
MVI  C,0E6H
CALL MOUT 
CALL MGHL 
XCHG
CALL MGHL 
XCHG
POP  H
MGM:MOV  C,M
CALL MOUT 
CALL DPCMP 
INX  H
JNZ  MGM 
LXI  H,00H
CALL MGHL 
MVI  C,0E6H
CALL MOUT 
POP  H
CALL MGHL 
JMP  ADR 
;
COLOR:MOV  C,L
MVI  A,06H
STA  PORTS1
MVI  A,01H
STA  PORTS2
LXI  H,INVERS 
MOV  D,M
MOV  M,C
CALL GTV 
MOV  M,D
XRA  A
STA  PORTS2
RET
;
STTS:XRA  A
STA  PKA 
LDA  PKB 
XRI  0FFH
RZ
MVI  A,0FFH
RET
;
READ:LXI  D,0BA00H
MOV  H,E
MOV  L,E
MVI  A,90H
STA  PDU 
RD:SHLD PDB 
LDA  PDA 
STAX D
INX  D
INX  H
MOV  A,H
CPI  06H
JNZ  RD 
JMP  0BFFDH
;
KBRD:PUSH B
PUSH D
PUSH H
CALL INKEY 
CPI  0FFH
JNZ  KB7 
STA  SIMV 
KB7:MVI  D,00H
KB2:INX  D
DCR  E
INR  E
CZ   MASC 
CALL INKEY 
INR  A
JZ   KB2 
KB0:PUSH PSW
MOV  A,D
RRC
CNC  MASC 
POP  PSW
DCR  A
JP   KB5 
LXI  H,FFIX 
MOV  A,M
CMA
MOV  M,A
STA  PKC 
KB6:CALL INKEY 
INR  A
JNZ  KB6 
CALL MASC 
JMP  KB7 
KB5:MOV  E,A
MVI  D,14H
LXI  H,SIMV 
CMP  M
JZ   KB4 
KB3:DCR  D
JZ   KB4 
CALL INKEY 
CMP  E
JZ   KB3 
KB4:CALL BEEP 
MOV  M,E
CALL MASC 
MOV  A,E
JMP  STR2 
;
INKEY:PUSH B
PUSH D
PUSH H
LXI  H,STR2 
PUSH H
MVI  B,00H
MVI  D,09H
MVI  C,0FEH
K2:MOV  A,C
STA  PKA 
RLC
MOV  C,A
LDA  PKB 
CPI  0FFH
JZ   K30 
MOV  E,A
CALL TIME 
LDA  PKB 
CMP  E
JZ   K5 
K30:MOV  A,B
ADI  08H
MOV  B,A
DCR  D
JNZ  K2 
LDA  PKC 
ANI  FIX
MVI  A,0FEH
RZ
INR  A
RET
;
K6:INR  B
K5:RAR
JC   K6 
MOV  A,B
ANI  3FH
CPI  10H
JC   K9 
CPI  3FH
MOV  B,A
MVI  A,20H
RZ
LDA  PKC 
MOV  C,A
ANI  US
JNZ  K63 
MOV  A,B
ANI  1FH
RET
;
K63:LDA  FFIX 
ANA  A
JNZ  K10 
MOV  A,C
ANI  SS
MOV  A,B
JZ   K61 
CPI  1CH
JM   K14 
CPI  20H
JM   K15 
JMP  K14 
K61:CPI  1CH
JC   K15 
K14:ADI  10H
K15:ADI  10H
POP  H
JMP  STR2 
K9:LXI  H,TABK1 
MOV  C,A
MVI  B,00H
DAD  B
MOV  A,M
RET
;
TABK1:DB 0CH,1FH,1BH
DB 0,1,2,3,4,9
DB 0AH,0DH,7FH
DB 8,19H,18H,1AH
;
K10:MOV  A,C
ANI  SS
MOV  A,B
JZ   K61 
CPI  1CH
JM   K14 
CPI  20H
JM   K15 
ADI  40H
RET
;
TIME:LXI  H,0B00H
TIME1:DCX  H
MOV  A,H
ORA  L
JNZ  TIME1 
RET
;
HDLN:MVI  A,0DH
CALL TV 
MVI  A,0AH
TV:PUSH B
MOV  C,A
JMP  TV3 
TV2:PUSH B
TV3:PUSH D
PUSH H
PUSH PSW
MOV  A,C
CPI  7FH
JNZ  TV4 
LDA  INVERS 
CMA
STA  INVERS 
JMP  V6 
TV4:MVI  H,20H
SUB  H
JC   OP1 
MOV  L,A
DAD  H
DAD  H
DAD  H
XCHG
LHLD ZNAKG
DAD  D
XCHG
CALL MASC1 
XCHG
MVI  A,16H
V22:PUSH PSW
PUSH H
LDA  INVERS 
XRA  M
ANI  3FH
MOV  L,A
LDA  TB1 
DCR  A
MVI  H,00H
V21:DAD  H
DAD  H
INR  A
JNZ  V21 
XCHG
MOV  A,B
XRA  M
ANA  M
ORA  D
MOV  M,A
INR  H
MOV  A,C
XRA  M
ANA  M
ORA  E
MOV  M,A
DCR  H
INR  L
XCHG
POP  H
INX  H
POP  PSW
SUI  03H
JP   V22 
LXI  H,ZERO
CPI  0F8H
JNZ  V22 
OP1:LHLD TVAD 
CALL OPER 
DAD  B
MOV  A,H
CPI  19H
JC   V3 
JNZ  V4 
INR  D
MOV  H,D
JZ   V3 
PUSH H
LXI  H,00H
DAD  SP
SHLD TIMES 
LDA  EKRED 
MOV  B,A
LDA  EKRAN 
MOV  H,A
MVI  L,0AH
SPHL
MVI  L,00H
RL0:MVI  C,3CH
RL1:POP  D
MOV  M,E
INR  L
MOV  M,D
INR  L
POP  D
MOV  M,E
INR  L
MOV  M,D
INR  L
DCR  C
JNZ  RL1 
LDA  INVERS 
RL2:INX  SP
MOV  M,A
INR  L
JNZ  RL2 
INR  H
DCR  B
JNZ  RL0 
LHLD TIMES 
SPHL
POP  H
V4:MVI  H,18H
V3:SHLD TVAD 
V6:POP  PSW
JMP  STR2 
;
OPER:DB 01H
ZERO:DB 00H
DB 01H
MOV  D,C
INR  A
CZ   GTV 
JZ   V5 
CPI  0EBH
RZ
DCR  D
ADI  05H
RZ
INR  D
MVI  B,0FFH
INR  A
RZ
MVI  C,0FCH
CPI  0EFH
RZ
LXI  B,00H
CPI  0F0H
JNZ  V8 
MOV  A,L
ANI  0E0H
ADI  20H
MOV  L,A
RET
V8:MVI  C,04H
INR  A
RZ
CPI  0EFH
JZ   BEEP 
ADI  0BH
JZ   V7 
INR  A
RNZ
V5:MOV  H,D
V7:MOV  L,D
MOV  B,D
MOV  C,D
RET
;
MASC1:LHLD TVAD 
MOV  A,L
RRC
MOV  L,A
RRC
ADD  L
MOV  B,A
MOV  L,H
LDA  EKRAN 
MOV  H,A
MOV  A,B
DCR  H
MS1:INR  H
SUI  04H
JNC  MS1 
STA  TB1 
PUSH H
LXI  H,0FCH
VT7:DAD  H
DAD  H
INR  A
JNZ  VT7 
MOV  B,H
MOV  C,L
POP  H
MOV  A,L
RLC
RLC
RLC
ADD  L
ADD  L
MOV  L,A
RET
;
MASC:CALL MASC1 
ADI  09H
MOV  L,A
MOV  A,B
XRA  M
MOV  M,A
INR  H
MOV  A,C
XRA  M
MOV  M,A
RET
;
GTV:PUSH PSW
PUSH H
LDA  EKRAN 
MOV  H,A
LDA  EKRED 
ADD  H
MOV  C,A
MVI  L,00H
LDA  INVERS 
MOV  B,A
GTV1:MOV  M,B
INX  H
MOV  A,H
CMP  C
JNZ  GTV1 
POP  H
POP  PSW
RET
;
BEEP:LXI  B,4014H
BP1:MOV  A,B
BP2:EI
DCR  A
JNZ  BP2 
MOV  A,B
BP3:DI
DCR  A
JNZ  BP3 
DCR  C
JNZ  BP1 
MOV  B,C
RET
;
TAB2:DB 1FH
DB ' ОРИОН-128.2',0
;
TAB3:DB   0DH,0AH,0AH
DB   ' =>',7,0
;
END
.@...@...